// SPDX-License-Identifier: GPL-2.0
// Copyright (c) 2015, The Linux Foundation. All rights reserved.
// Copyright (c) 2023, Benarji Anand <benarji385@gmail.com>

/dts-v1/;

#include "msm8956.dtsi"
#include "msm8956-qrd-skun.dtsi"

/ {
	model = "Qualcomm Technologies, Inc. MSM8956 QRD SKUN";
	compatible = "qcom,msm8956-qrd-skun", "qcom,msm8956-qrd", "qcom,msm8956", "qcom,qrd";
	qcom,board-id= <0xb 0>;
};
