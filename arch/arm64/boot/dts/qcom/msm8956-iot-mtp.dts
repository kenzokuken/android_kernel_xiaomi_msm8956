// SPDX-License-Identifier: GPL-2.0
// Copyright (c) 2015, The Linux Foundation. All rights reserved.
// Copyright (c) 2022, Benarji Anand <benarji385@gmail.com>

/dts-v1/;

#include "msm8956.dtsi"
#include "pmi8950.dtsi"
#include "msm8956-mtp.dtsi"
#include "msm8956-pmi8950.dtsi"

/ {
	model = "Qualcomm Technologies, Inc. MSM8956 + PMI8950 IOT MTP";
	compatible = "qcom,msm8956-mtp", "qcom,msm8956", "qcom,mtp";
	qcom,board-id= <8 2>;
	qcom,pmic-id = <0x010016 0x010011 0x0 0x0>;
};

&kgsl_smmu {
	qcom,hibernation-support;
	qcom,static-ns-cbs = <0>;
	/delete-property/ qcom,skip-init;
};

&apps_iommu {
	qcom,hibernation-support;
	qcom,static-ns-cbs =
			<15 16 17 18 19>,
			<20 21 22 23 24 25 26 27 28 29 30>,
			<31>;

	/delete-property/ qcom,skip-init;
};
