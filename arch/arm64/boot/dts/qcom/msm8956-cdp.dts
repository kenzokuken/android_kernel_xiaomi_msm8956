// SPDX-License-Identifier: GPL-2.0
// Copyright (c) 2015, The Linux Foundation. All rights reserved.
// Copyright (c) 2022, Benarji Anand <benarji385@gmail.com>

/dts-v1/;

#include "msm8956.dtsi"
#include "msm8956-cdp.dtsi"

/ {
	model = "Qualcomm Technologies, Inc. MSM8956 CDP";
	compatible = "qcom,msm8956-cdp", "qcom,msm8956", "qcom,cdp";
	qcom,board-id= <1 0>;
};
