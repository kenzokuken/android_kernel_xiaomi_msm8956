// SPDX-License-Identifier: GPL-2.0
// Copyright (c) 2014-2015, The Linux Foundation. All rights reserved.
// Copyright (c) 2024, Benarji Anand <benarji385@gmail.com>

/dts-v1/;

#include "msm8956.dtsi"
#include "msm8976-audio.dtsi"
#include "msm8956-pmi8950.dtsi"

/ {
	model = "Qualcomm Technologies, Inc. MSM8956 + PMI8950 SOC ";
	compatible = "qcom,msm8956";
	qcom,pmic-id = <0x10019 0x010011 0x0 0x0>;
	qcom,pmic-name = "PMI8950";
};
