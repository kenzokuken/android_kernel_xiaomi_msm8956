// SPDX-License-Identifier: GPL-2.0
// Copyright (c) 2015, The Linux Foundation. All rights reserved.
// Copyright (c) 2024, Benarji Anand <benarji385@gmail.com>

/*
 * NOTE:
 * As a general rule, only version-specific property overrides should be placed
 * inside this file. However, device definitions should be placed inside the
 * msm8956.dtsi file.
 */

#include "msm8956.dtsi"
#include "msm8976-v1.1.dtsi"

/ {
	model = "Qualcomm Technologies, Inc. MSM8956 v1.1";
	compatible = "qcom,msm8956";
	qcom,msm-id = <266 0x0>;
};
