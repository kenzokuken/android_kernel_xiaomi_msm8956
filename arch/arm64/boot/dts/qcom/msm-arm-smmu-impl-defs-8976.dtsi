// SPDX-License-Identifier: GPL-2.0
// Copyright (c) 2014-2015, The Linux Foundation. All rights reserved.
// Copyright (c) 2023, Benarji Anand <benarji385@gmail.com>

&kgsl_smmu {
	attach-impl-defs = <0x6000 0x270>,
		<0x6060 0x1055>,
		<0x6800 0x6>,
		<0x6900 0x3ff>,
		<0x6924 0x204>,
		<0x6928 0x10800>,
		<0x6930 0x400>,
		<0x6960 0xffffffff>,
		<0x6b64 0xa0000>,
		<0x6b68 0xaaab92a>;
};

