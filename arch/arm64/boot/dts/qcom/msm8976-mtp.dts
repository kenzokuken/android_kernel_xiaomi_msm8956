// SPDX-License-Identifier: GPL-2.0
// Copyright (c) 2015, The Linux Foundation. All rights reserved.
// Copyright (c) 2024, Benarji Anand <benarji385@gmail.com>

/dts-v1/;
#include "msm8976.dtsi"
#include "msm8976-mtp.dtsi"

/ {
	model = "Qualcomm Technologies, Inc. MSM8976 MTP";
	compatible = "qcom,msm8976-mtp", "qcom,msm8976", "qcom,mtp";
	qcom,board-id= <8 0>;

	mtp_batterydata: qcom,battery-data {
		qcom,batt-id-range-pct = <15>;
		#include "batterydata-coslight-4000mah-4400mv.dtsi"
		#include "batterydata-coslight-4000mah-4400mv-10k.dtsi"
		#include "batterydata-sunwoda-4000mah-4400mv.dtsi"
		};
};

&pmi8950_fg {
	qcom,battery-data = <&mtp_batterydata>;
};

&pmi8950_charger {
	qcom,battery-data = <&mtp_batterydata>;
	qcom,chg-led-support;
	qcom,chg-led-sw-controls;
};
